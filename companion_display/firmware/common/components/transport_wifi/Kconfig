## companion_display/firmware/common/components/transport_wifi/Kconfig
```kconfig
menu "Companion Display Wi-Fi"
config COMPANION_DISPLAY_WIDTH
    int "Negotiated display width (px)"
    default 368
    help
        Physical panel width advertised in hello_ack and /api/status. The PC
        client scales, letterboxes and encodes to exactly this size, and the
        board's display module must accept frames of this width. Must match
        the board component's panel resolution.
config COMPANION_DISPLAY_HEIGHT
    int "Negotiated display height (px)"
    default 448
    help
        Physical panel height advertised in hello_ack and /api/status. See
        COMPANION_DISPLAY_WIDTH.
config COMPANION_HTTP_PORT
    int "HTTP and WebSocket port"
    default 80
config COMPANION_UDP_PORT
    int "UDP video port"
    default 5000
config COMPANION_AP_PASSWORD
    string "Provisioning AP password"
    default "companion-display"
config COMPANION_FRAME_TIMEOUT_MS
    int "Video frame idle timeout (ms)"
    range 2000 60000
    default 10000
    help
        After start_stream, if no complete video frame is received for this
        long the device ends the session, closes the control connection and
        returns to the main info screen. The PC client repeats a keepalive
        frame at 1 FPS for static content, so the default of 10 seconds only
        triggers when the stream is genuinely gone.
endmenu
```

## companion_display/firmware/esp32p4/components/companion_board/Kconfig
```kconfig
menu "Companion Board (JC1060P470)"
config BOARD_JC1060_DSI_LANE_BITRATE_MBPS
    int "MIPI DSI lane bitrate (Mbps)"
    default 600
    help
        Per-lane DSI bitrate. 600 Mbps matches the reference project default;
        boards that fail to initialize the panel at 600 have been validated at
        750 Mbps.
config BOARD_JC1060_TOUCH_NATIVE_H_RES
    int "GT911 native horizontal resolution"
    default 800
    help
        The GT911 firmware on this panel batch reports an 800x480 coordinate
        space that the board component scales to the 1024x600 panel. Adjust if
        a different panel batch reports native coordinates.
config BOARD_JC1060_TOUCH_NATIVE_V_RES
    int "GT911 native vertical resolution"
    default 480
config BOARD_JC1060_BACKLIGHT_PERCENT
    int "Backlight brightness after init (percent)"
    range 1 100
    default 80
config BOARD_JC1060_NETWORK_READY_TIMEOUT_MS
    int "ESP-Hosted transport ready timeout (ms)"
    default 15000
endmenu
```

## companion_display/firmware/esp32p4/sdkconfig.defaults
```kconfig
CONFIG_IDF_TARGET="esp32p4"
CONFIG_ESPTOOLPY_FLASHSIZE_16MB=y
CONFIG_PARTITION_TABLE_CUSTOM=y
CONFIG_PARTITION_TABLE_CUSTOM_FILENAME="partitions.csv"
CONFIG_COMPILER_OPTIMIZATION_PERF=y
CONFIG_FREERTOS_HZ=200
CONFIG_IDF_EXPERIMENTAL_FEATURES=y
CONFIG_HTTPD_WS_SUPPORT=y
CONFIG_COMPANION_DISPLAY_WIDTH=1024
CONFIG_COMPANION_DISPLAY_HEIGHT=600
CONFIG_COMPANION_FRAME_LIMIT_KB=384
CONFIG_COMPANION_FRAME_BUFFER_COUNT=2
CONFIG_COMPANION_DRAW_TASK_PRIORITY=5
CONFIG_COMPANION_HTTP_PORT=80
CONFIG_COMPANION_UDP_PORT=5000
CONFIG_COMPANION_AP_PASSWORD="companion-display"
```

## companion_display/firmware/esp32s3/components/board_amoled_1_8/Kconfig
```kconfig
menu "Board AMOLED 1.8"

config BOARD_AMOLED_1_8_I2C_PORT
    int "I2C port"
    default 0

config BOARD_AMOLED_1_8_I2C_SDA_GPIO
    int "I2C SDA GPIO"
    default 15

config BOARD_AMOLED_1_8_I2C_SCL_GPIO
    int "I2C SCL GPIO"
    default 14

config BOARD_AMOLED_1_8_I2C_HZ
    int "I2C bus frequency"
    default 400000

config BOARD_AMOLED_1_8_LCD_CS_GPIO
    int "LCD CS GPIO"
    default 12

config BOARD_AMOLED_1_8_LCD_PCLK_GPIO
    int "LCD PCLK GPIO"
    default 11

config BOARD_AMOLED_1_8_LCD_PCLK_HZ
    int "LCD QSPI clock frequency"
    range 1000000 80000000
    default 40000000
    help
        QSPI clock used for SH8601 command and color transfers. The default
        matches the Waveshare SH8601 component's conservative setting.

config BOARD_AMOLED_1_8_LCD_D0_GPIO
    int "LCD DATA0 GPIO"
    default 4

config BOARD_AMOLED_1_8_LCD_D1_GPIO
    int "LCD DATA1 GPIO"
    default 5

config BOARD_AMOLED_1_8_LCD_D2_GPIO
    int "LCD DATA2 GPIO"
    default 6

config BOARD_AMOLED_1_8_LCD_D3_GPIO
    int "LCD DATA3 GPIO"
    default 7

config BOARD_AMOLED_1_8_LCD_TE_GPIO
    int "LCD TE GPIO (-1 for NC)"
    default 13

config BOARD_AMOLED_1_8_LCD_RST_GPIO
    int "LCD RST GPIO (-1 for NC)"
    default -1

config BOARD_AMOLED_1_8_LCD_POWER_EXIO_NUM
    int "LCD power enable EXIO number (-1 for none)"
    default 1

config BOARD_AMOLED_1_8_LCD_POWER_ACTIVE_LEVEL
    int "LCD power enable active level"
    range 0 1
    default 1

config BOARD_AMOLED_1_8_LCD_RST_EXIO_NUM
    int "LCD RST EXIO number (-1 for none)"
    default 0

config BOARD_AMOLED_1_8_LCD_RST_ACTIVE_LEVEL
    int "LCD RST active level"
    range 0 1
    default 0

config BOARD_AMOLED_1_8_LCD_H_RES
    int "LCD horizontal resolution"
    default 368

config BOARD_AMOLED_1_8_LCD_V_RES
    int "LCD vertical resolution"
    default 448

config BOARD_AMOLED_1_8_LCD_SPI_HOST
    int "LCD SPI host (SPI2_HOST=2)"
    default 2

config BOARD_AMOLED_1_8_TOUCH_INT_GPIO
    int "Touch INT GPIO"
    default 21

config BOARD_AMOLED_1_8_TOUCH_RST_GPIO
    int "Touch RST GPIO (-1 for NC)"
    default -1

config BOARD_AMOLED_1_8_TOUCH_RST_EXIO_NUM
    int "Touch RST EXIO number (-1 for none)"
    default 2

config BOARD_AMOLED_1_8_TOUCH_RST_ACTIVE_LEVEL
    int "Touch RST active level"
    range 0 1
    default 0

config BOARD_AMOLED_1_8_SD_D0_GPIO
    int "SD D0 GPIO"
    default 3

config BOARD_AMOLED_1_8_SD_CMD_GPIO
    int "SD CMD GPIO"
    default 1

config BOARD_AMOLED_1_8_SD_CLK_GPIO
    int "SD CLK GPIO"
    default 2

config BOARD_AMOLED_1_8_I2S_MCLK_GPIO
    int "I2S MCLK GPIO"
    default 16

config BOARD_AMOLED_1_8_I2S_BCLK_GPIO
    int "I2S BCLK GPIO"
    default 9

config BOARD_AMOLED_1_8_I2S_LRCK_GPIO
    int "I2S LRCK GPIO"
    default 45

config BOARD_AMOLED_1_8_I2S_DOUT_GPIO
    int "I2S DOUT GPIO"
    default 8

config BOARD_AMOLED_1_8_I2S_DIN_GPIO
    int "I2S DIN GPIO"
    default 10

config BOARD_AMOLED_1_8_PA_ENABLE_GPIO
    int "Power amplifier enable GPIO"
    default 46

config BOARD_AMOLED_1_8_ES8311_ADDR
    hex "ES8311 I2C address"
    default 0x18

config BOARD_AMOLED_1_8_TCA9554_ADDR
    hex "TCA9554 I2C address"
    default 0x20

config BOARD_AMOLED_1_8_FT3168_ADDR
    hex "FT3168 I2C address"
    default 0x38

config BOARD_AMOLED_1_8_PCF85063_ADDR
    hex "PCF85063 I2C address"
    default 0x51

config BOARD_AMOLED_1_8_QMI8658_ADDR
    hex "QMI8658 I2C address"
    default 0x6B

config BOARD_AMOLED_1_8_AXP2101_ADDR
    hex "AXP2101 I2C address"
    default 0x34

config BOARD_AMOLED_1_8_DISPLAY_ONLY_DIAG
    bool "Display-only diagnostic mode"
    default n

config BOARD_AMOLED_1_8_DISPLAY_PMU_PREPARE_DELAY_MS
    int "Display PMU prepare delay (ms)"
    range 0 1000
    default 80

config BOARD_AMOLED_1_8_DISPLAY_POWER_OFF_HOLD_MS
    int "Display power-off hold delay (ms)"
    range 0 1000
    default 30

config BOARD_AMOLED_1_8_DISPLAY_POWER_ON_SETTLE_MS
    int "Display power-on settle delay (ms)"
    range 0 1000
    default 120

config BOARD_AMOLED_1_8_DISPLAY_PANEL_RESET_SETTLE_MS
    int "Display panel reset settle delay (ms)"
    range 0 1000
    default 150

config BOARD_AMOLED_1_8_DISPLAY_PANEL_INIT_SETTLE_MS
    int "Display panel init settle delay (ms)"
    range 0 1000
    default 200

config BOARD_AMOLED_1_8_DISPLAY_DISP_ON_SETTLE_MS
    int "Display disp_on settle delay (ms)"
    range 0 1000
    default 120

config BOARD_AMOLED_1_8_DISPLAY_POST_INIT_DELAY_MS
    int "Display post-init settle delay (ms)"
    range 0 1000
    default 120

config BOARD_AMOLED_1_8_DISPLAY_LOW_BRIGHTNESS_PERCENT
    int "Display staged low brightness percent"
    range 0 100
    default 20

config BOARD_AMOLED_1_8_DISPLAY_DEFAULT_BRIGHTNESS_PERCENT
    int "Display default brightness percent"
    range 0 100
    default 80

config BOARD_AMOLED_1_8_DISPLAY_SELF_TEST_DELAY_MS
    int "Display self-test pre-delay (ms)"
    range 0 1000
    default 150

config BOARD_AMOLED_1_8_DISPLAY_BRIGHTNESS_SETTLE_DELAY_MS
    int "Display brightness settle delay (ms)"
    range 0 1000
    default 50

config BOARD_AMOLED_1_8_DISPLAY_DELAY_I2C_SCAN
    bool "Delay I2C scan until after display self-test"
    default y

endmenu
```

## companion_display/firmware/esp32s3/components/frame_pipeline/Kconfig
```kconfig
menu "Companion Display"
config COMPANION_FRAME_LIMIT_KB
    int "Maximum JPEG frame size (KiB)"
    default 100
config COMPANION_FRAME_BUFFER_COUNT
    int "PSRAM frame buffer count"
    default 3
config COMPANION_DRAW_TASK_PRIORITY
    int "Frame draw task priority"
    default 5
endmenu
```

## companion_display/firmware/esp32s3/components/transport_wifi/Kconfig
```kconfig
menu "Companion Display Wi-Fi"
config COMPANION_HTTP_PORT
    int "HTTP and WebSocket port"
    default 80
config COMPANION_UDP_PORT
    int "UDP video port"
    default 5000
config COMPANION_AP_PASSWORD
    string "Provisioning AP password"
    default "companion-display"
config COMPANION_FRAME_TIMEOUT_MS
    int "Video frame idle timeout (ms)"
    range 2000 60000
    default 10000
    help
        After start_stream, if no complete video frame is received for this
        long the device ends the session, closes the control connection and
        returns to the main info screen. The PC client repeats a keepalive
        frame at 1 FPS for static content, so the default of 10 seconds only
        triggers when the stream is genuinely gone.
endmenu
```

## companion_display/firmware/esp32s3/sdkconfig.defaults
```kconfig
CONFIG_IDF_TARGET="esp32s3"
CONFIG_ESPTOOLPY_FLASHMODE_QIO=y
CONFIG_ESPTOOLPY_FLASHSIZE_16MB=y
CONFIG_SPIRAM=y
CONFIG_SPIRAM_MODE_OCT=y
CONFIG_SPIRAM_SPEED_80M=y
CONFIG_SPIRAM_FETCH_INSTRUCTIONS=y
CONFIG_SPIRAM_RODATA=y
CONFIG_SPIRAM_XIP_FROM_PSRAM=y
CONFIG_ESP_DEFAULT_CPU_FREQ_MHZ_240=y
CONFIG_ESP_CONSOLE_UART_CUSTOM=y
CONFIG_ESP_CONSOLE_UART_BAUDRATE=2000000
CONFIG_COMPILER_OPTIMIZATION_PERF=y
CONFIG_HTTPD_WS_SUPPORT=y
CONFIG_ESP_WIFI_STATIC_RX_BUFFER_NUM=16
CONFIG_ESP_WIFI_DYNAMIC_RX_BUFFER_NUM=48
CONFIG_ESP_WIFI_RX_BA_WIN=16
CONFIG_LWIP_UDP_RECVMBOX_SIZE=48
CONFIG_COMPANION_DISPLAY_WIDTH=368
CONFIG_COMPANION_DISPLAY_HEIGHT=448
CONFIG_COMPANION_FRAME_LIMIT_KB=100
CONFIG_COMPANION_FRAME_BUFFER_COUNT=2
CONFIG_COMPANION_DRAW_TASK_PRIORITY=5
CONFIG_COMPANION_HTTP_PORT=80
CONFIG_COMPANION_UDP_PORT=5000
CONFIG_COMPANION_AP_PASSWORD="companion-display"
CONFIG_JD_USE_ROM=n
CONFIG_JD_SZBUF=1024
CONFIG_JD_FORMAT_RGB565=y
CONFIG_JD_USE_SCALE=n
CONFIG_JD_TBLCLIP=y
CONFIG_JD_FASTDECODE_TABLE=y
CONFIG_BOARD_AMOLED_1_8_I2C_PORT=0
CONFIG_BOARD_AMOLED_1_8_I2C_SDA_GPIO=15
CONFIG_BOARD_AMOLED_1_8_I2C_SCL_GPIO=14
CONFIG_BOARD_AMOLED_1_8_I2C_HZ=400000
CONFIG_BOARD_AMOLED_1_8_LCD_CS_GPIO=12
CONFIG_BOARD_AMOLED_1_8_LCD_PCLK_GPIO=11
CONFIG_BOARD_AMOLED_1_8_LCD_PCLK_HZ=40000000
CONFIG_BOARD_AMOLED_1_8_LCD_D0_GPIO=4
CONFIG_BOARD_AMOLED_1_8_LCD_D1_GPIO=5
CONFIG_BOARD_AMOLED_1_8_LCD_D2_GPIO=6
CONFIG_BOARD_AMOLED_1_8_LCD_D3_GPIO=7
CONFIG_BOARD_AMOLED_1_8_LCD_TE_GPIO=13
CONFIG_BOARD_AMOLED_1_8_LCD_RST_GPIO=-1
CONFIG_BOARD_AMOLED_1_8_LCD_POWER_EXIO_NUM=1
CONFIG_BOARD_AMOLED_1_8_LCD_POWER_ACTIVE_LEVEL=1
CONFIG_BOARD_AMOLED_1_8_LCD_RST_EXIO_NUM=0
CONFIG_BOARD_AMOLED_1_8_LCD_RST_ACTIVE_LEVEL=0
CONFIG_BOARD_AMOLED_1_8_LCD_H_RES=368
CONFIG_BOARD_AMOLED_1_8_LCD_V_RES=448
CONFIG_BOARD_AMOLED_1_8_LCD_SPI_HOST=2
CONFIG_BOARD_AMOLED_1_8_TOUCH_INT_GPIO=21
CONFIG_BOARD_AMOLED_1_8_TOUCH_RST_GPIO=-1
CONFIG_BOARD_AMOLED_1_8_TOUCH_RST_EXIO_NUM=2
CONFIG_BOARD_AMOLED_1_8_TOUCH_RST_ACTIVE_LEVEL=0
CONFIG_BOARD_AMOLED_1_8_SD_D0_GPIO=3
CONFIG_BOARD_AMOLED_1_8_SD_CMD_GPIO=1
CONFIG_BOARD_AMOLED_1_8_SD_CLK_GPIO=2
CONFIG_BOARD_AMOLED_1_8_I2S_MCLK_GPIO=16
CONFIG_BOARD_AMOLED_1_8_I2S_BCLK_GPIO=9
CONFIG_BOARD_AMOLED_1_8_I2S_LRCK_GPIO=45
CONFIG_BOARD_AMOLED_1_8_I2S_DOUT_GPIO=8
CONFIG_BOARD_AMOLED_1_8_I2S_DIN_GPIO=10
CONFIG_BOARD_AMOLED_1_8_PA_ENABLE_GPIO=46
CONFIG_BOARD_AMOLED_1_8_ES8311_ADDR=0x18
CONFIG_BOARD_AMOLED_1_8_TCA9554_ADDR=0x20
CONFIG_BOARD_AMOLED_1_8_FT3168_ADDR=0x38
CONFIG_BOARD_AMOLED_1_8_PCF85063_ADDR=0x51
CONFIG_BOARD_AMOLED_1_8_QMI8658_ADDR=0x6B
CONFIG_BOARD_AMOLED_1_8_AXP2101_ADDR=0x34
CONFIG_BOARD_AMOLED_1_8_DISPLAY_ONLY_DIAG=n
CONFIG_BOARD_AMOLED_1_8_DISPLAY_PMU_PREPARE_DELAY_MS=100
CONFIG_BOARD_AMOLED_1_8_DISPLAY_POWER_OFF_HOLD_MS=150
CONFIG_BOARD_AMOLED_1_8_DISPLAY_POWER_ON_SETTLE_MS=350
CONFIG_BOARD_AMOLED_1_8_DISPLAY_PANEL_RESET_SETTLE_MS=150
CONFIG_BOARD_AMOLED_1_8_DISPLAY_PANEL_INIT_SETTLE_MS=200
CONFIG_BOARD_AMOLED_1_8_DISPLAY_DISP_ON_SETTLE_MS=120
CONFIG_BOARD_AMOLED_1_8_DISPLAY_POST_INIT_DELAY_MS=200
CONFIG_BOARD_AMOLED_1_8_DISPLAY_LOW_BRIGHTNESS_PERCENT=20
CONFIG_BOARD_AMOLED_1_8_DISPLAY_DEFAULT_BRIGHTNESS_PERCENT=80
CONFIG_BOARD_AMOLED_1_8_DISPLAY_SELF_TEST_DELAY_MS=250
CONFIG_BOARD_AMOLED_1_8_DISPLAY_BRIGHTNESS_SETTLE_DELAY_MS=120
CONFIG_BOARD_AMOLED_1_8_DISPLAY_DELAY_I2C_SCAN=y
```
