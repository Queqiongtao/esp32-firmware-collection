## esp32s3/clock/components/esp32_s3_touch_amoled_1_75/Kconfig
```kconfig
menu "Board Support Package"

    config BSP_ERROR_CHECK
        bool "Enable error check in BSP"
        default y
        help
            Error check assert the application before returning the error code.

    menu "I2C"
        config BSP_I2C_NUM
            int "I2C peripheral index"
            default 1
            range 0 1
            help
                ESP32-S2 has two I2C peripherals, pick the one you want to use.

        config BSP_I2C_FAST_MODE
            bool "Enable I2C fast mode"
            default y
            help
                I2C has two speed modes: normal (100kHz) and fast (400kHz).

        config BSP_I2C_CLK_SPEED_HZ
            int
            default 400000 if BSP_I2C_FAST_MODE
            default 100000
    endmenu

    menu "SPIFFS - Virtual File System"
        config BSP_SPIFFS_FORMAT_ON_MOUNT_FAIL
            bool "Format SPIFFS if mounting fails"
            default n
            help
                Format SPIFFS if it fails to mount the filesystem.

        config BSP_SPIFFS_MOUNT_POINT
            string "SPIFFS mount point"
            default "/spiffs"
            help
                Mount point of SPIFFS in the Virtual File System.

        config BSP_SPIFFS_PARTITION_LABEL
            string "Partition label of SPIFFS"
            default "storage"
            help
                Partition label which stores SPIFFS.

        config BSP_SPIFFS_MAX_FILES
            int "Maximum files that could be open at the same time"
            default 2
            help
                Supported max files for SPIFFS in the Virtual File System.
    endmenu

    menu "uSD card - Virtual File System"
        config BSP_SD_FORMAT_ON_MOUNT_FAIL
            bool "Format uSD card if mounting fails"
            default n
            help
                The SDMMC host will format (FAT) the uSD card if it fails to mount the filesystem.

        config BSP_SD_MOUNT_POINT
            string "uSD card mount point"
            default "/sdcard"
            help
                Mount point of the uSD card in the Virtual File System

    endmenu
    menu "Display"
        config BSP_LCD_SPI_PCLK_HZ
            int "Set CO5300 QSPI pixel clock frequency"
            default 60000000
            range 20000000 80000000
            help
                Pixel clock frequency for the CO5300 QSPI LCD panel.
                60 MHz is the component default for smoother full-screen clock rotation.
                If the panel shows artifacts or SPI DMA underflow, reduce this value.

        config BSP_LCD_LVGL_BUFFER_HEIGHT
            int "Set LVGL draw buffer height in pixels"
            default 80
            range 40 466
            help
                Height of each LVGL partial draw buffer. Larger values reduce the number of
                chunks needed for full-screen rotated clock refreshes, but consume more PSRAM.
                The clock app uses double buffering, so memory is roughly width * height * 2
                bytes * 2 buffers.

        config BSP_LCD_TRANS_QUEUE_DEPTH
            int "Set The depth of the SPI transmission task queue for the SPI screen"
            default 1
            range 1 2
            help
                Keep this low for the CO5300 QSPI panel when LVGL draw buffers are in RAM/PSRAM.
                Higher queue depths can let LVGL enqueue the next parameter transaction while a
                previous color DMA transfer is still being recycled, which can trigger SPI DMA
                underflow on ESP-IDF 6.

        config BSP_LCD_TE_SYNC_ENABLE
            bool "Enable CO5300 TE synchronized refresh"
            default y
            help
                Use the CO5300 tearing effect signal on GPIO13 to synchronize LVGL flushes with
                the AMOLED panel refresh. This reduces visible tearing during large rotated
                clock updates. Disable this if the TE line is unavailable on a board revision.
    endmenu

    config BSP_I2S_NUM
        int "I2S peripheral index"
        default 1
        range 0 1
        help
            ESP32S3 has two I2S peripherals, pick the one you want to use.
endmenu
```

## esp32s3/companion_display/components/transport_usb/Kconfig
```kconfig
menu "Companion Display USB"
config COMPANION_USB_VID
    hex "USB vendor ID"
    default 0x303A
config COMPANION_USB_PID
    hex "USB product ID"
    default 0x4001
config COMPANION_USB_TASK_PRIORITY
    int "TinyUSB task priority"
    default 6
endmenu
```

## esp32s3/companion_display/components/transport_wifi/Kconfig
```kconfig
menu "Companion Display Wi-Fi"
config COMPANION_HTTP_PORT
    int "HTTP and WebSocket port"
    default 80
config COMPANION_UDP_PORT
    int "UDP video port"
    default 5000
config COMPANION_AP_PASSWORD
    string "Provisioning AP password"
    default "companion-display"
endmenu
```

## esp32s3/waveshare_amoled_1_8/components/board_amoled_1_8/Kconfig
```kconfig
menu "Board AMOLED 1.8"

config BOARD_AMOLED_1_8_I2C_SDA_GPIO
    int "I2C SDA GPIO"
    default 15

config BOARD_AMOLED_1_8_I2C_SCL_GPIO
    int "I2C SCL GPIO"
    default 14

config BOARD_AMOLED_1_8_I2C_PORT
    int "I2C port"
    default 0

config BOARD_AMOLED_1_8_I2C_HZ
    int "I2C bus frequency"
    default 400000

config BOARD_AMOLED_1_8_BACKLIGHT_GPIO
    int "Backlight GPIO"
    default 6

config BOARD_AMOLED_1_8_BACKLIGHT_LEDC_CHANNEL
    int "Backlight LEDC channel"
    default 0

config BOARD_AMOLED_1_8_BACKLIGHT_LEDC_TIMER
    int "Backlight LEDC timer"
    default 0

config BOARD_AMOLED_1_8_BACKLIGHT_LEDC_MODE
    int "Backlight LEDC mode"
    default 0

config BOARD_AMOLED_1_8_BACKLIGHT_FREQ_HZ
    int "Backlight PWM frequency"
    default 5000

config BOARD_AMOLED_1_8_BACKLIGHT_INVERT
    bool "Invert backlight duty"
    default n

endmenu
```

## esp32s3/waveshare_amoled_1_8/sdkconfig.defaults
```kconfig
# This file can be edited manually.
CONFIG_IDF_TARGET="esp32s3"
CONFIG_ESPTOOLPY_FLASHMODE_QIO=y
CONFIG_ESPTOOLPY_FLASHSIZE_16MB=y
CONFIG_SPIRAM=y
CONFIG_SPIRAM_MODE_OCT=y
CONFIG_SPIRAM_SPEED_80M=y
CONFIG_SPIRAM_FETCH_INSTRUCTIONS=y
CONFIG_SPIRAM_RODATA=y
CONFIG_SPIRAM_XIP_FROM_PSRAM=y
CONFIG_ESP_DEFAULT_CPU_FREQ_MHZ_240=y
CONFIG_ESP_CONSOLE_UART_CUSTOM=y
CONFIG_ESP_CONSOLE_UART_BAUDRATE=2000000
CONFIG_COMPILER_OPTIMIZATION_PERF=y
CONFIG_BOARD_AMOLED_1_8_I2C_SDA_GPIO=15
CONFIG_BOARD_AMOLED_1_8_I2C_SCL_GPIO=14
CONFIG_BOARD_AMOLED_1_8_I2C_PORT=0
CONFIG_BOARD_AMOLED_1_8_I2C_HZ=400000
CONFIG_BOARD_AMOLED_1_8_BACKLIGHT_GPIO=6
CONFIG_BOARD_AMOLED_1_8_BACKLIGHT_LEDC_CHANNEL=0
CONFIG_BOARD_AMOLED_1_8_BACKLIGHT_LEDC_TIMER=0
CONFIG_BOARD_AMOLED_1_8_BACKLIGHT_LEDC_MODE=0
CONFIG_BOARD_AMOLED_1_8_BACKLIGHT_FREQ_HZ=5000
```
