## esp32p4/JC1060P470/main/Kconfig.projbuild
```kconfig
menu "Example Configuration"
    config EXAMPLE_FONT_FILE_NAME
        string "External UI font file name"
        default "ui_shs_sc.otf"
        help
            Subset font stored in the dedicated font SPIFFS partition and
            loaded through LVGL FreeType backend.

    config EXAMPLE_USE_DMA2D_COPY_FRAME
        bool "Use ESP LCD DMA2D draw_bitmap hook"
        default y
        help
            Enable ESP LCD DPI panel DMA2D draw_bitmap hook. This accelerates
            draw buffer to frame buffer copies when the selected LVGL render
            path calls esp_lcd_panel_draw_bitmap(). It is separate from LVGL's
            STM32-only LV_USE_DRAW_DMA2D option.

    choice EXAMPLE_LVGL_PORT_IMPL
        prompt "LVGL port implementation"
        default EXAMPLE_LVGL_PORT_ESP_ADAPTER
        help
            Select the LVGL display/input adapter. The ESP adapter path uses
            Espressif's display bridge, PPA helpers, and tear avoidance modes.
            The legacy path keeps this project's original DIRECT dual-fb port
            as a fallback for display bring-up.

        config EXAMPLE_LVGL_PORT_ESP_ADAPTER
            bool "Espressif esp_lvgl_adapter"
        config EXAMPLE_LVGL_PORT_CUSTOM_LEGACY
            bool "Project legacy LVGL port"
    endchoice

    choice EXAMPLE_LVGL_ADAPTER_TEAR_MODE
        prompt "esp_lvgl_adapter tear avoidance mode"
        depends on EXAMPLE_LVGL_PORT_ESP_ADAPTER
        default EXAMPLE_LVGL_ADAPTER_TEAR_DOUBLE_DIRECT
        help
            DOUBLE_DIRECT is closest to the previous stable DIRECT dual
            framebuffer path. TRIPLE_PARTIAL follows the adapter's high
            resolution default and gives DMA2D draw_bitmap more copy work, but
            uses more PSRAM.

        config EXAMPLE_LVGL_ADAPTER_TEAR_DOUBLE_DIRECT
            bool "DOUBLE_DIRECT"
        config EXAMPLE_LVGL_ADAPTER_TEAR_TRIPLE_PARTIAL
            bool "TRIPLE_PARTIAL"
        config EXAMPLE_LVGL_ADAPTER_TEAR_DOUBLE_FULL
            bool "DOUBLE_FULL"
    endchoice

    config EXAMPLE_LVGL_ADAPTER_FORCE_PARTIAL_DMA2D_TEST
        bool "Force adapter TRIPLE_PARTIAL for DMA2D copy testing"
        depends on EXAMPLE_LVGL_PORT_ESP_ADAPTER
        default n
        help
            Force TRIPLE_PARTIAL mode regardless of the selected tear mode.
            Use this only for comparing DMA2D draw_bitmap copy load against
            DIRECT mode.

    config EXAMPLE_LVGL_ADAPTER_ENABLE_PPA_ACCEL
        bool "Enable esp_lvgl_adapter PPA acceleration hints"
        depends on EXAMPLE_LVGL_PORT_ESP_ADAPTER
        default y
        help
            Pass enable_ppa_accel to esp_lvgl_adapter display profile and keep
            LVGL's built-in Espressif PPA draw backend disabled. The adapter
            owns the PPA acceleration hooks for this project.

    config EXAMPLE_LCD_BACKLIGHT_BYPASS_PWM
        bool "Bypass PWM and force backlight always on"
        default n
        help
            Enable this option to drive the backlight pin as a fixed high level instead of PWM.
            This is useful for diagnosing whether visible flicker comes from PWM dimming or from the display pipeline.

    config EXAMPLE_LVGL_PERF_LOG
        bool "Log LVGL refresh performance"
        default y
        help
            Log LVGL refresh, render, and flush timing to help distinguish UI rendering FPS from panel refresh rate.

    config EXAMPLE_LVGL_DRAW_BUF_LINES
        int "LVGL draw buffer lines"
        range 10 200
        default 80
        help
            Number of LCD lines in each LVGL partial draw buffer.
            Smaller values reduce single-buffer size and internal memory pressure.
            Larger values reduce flush count but consume more memory.

    choice
        prompt "LVGL draw buffer memory"
        default EXAMPLE_LVGL_DRAW_BUF_PSRAM
        help
            Select where the LVGL partial draw buffers are allocated from.

        config EXAMPLE_LVGL_DRAW_BUF_PSRAM
            bool "PSRAM"
        config EXAMPLE_LVGL_DRAW_BUF_INTERNAL
            bool "Internal RAM"
    endchoice

    config EXAMPLE_ENABLE_TEST_SDCARD
        bool "Enable SD card (SDMMC) test module"
        default y
        help
            Enable this option to initialize the SDMMC host, mount a FAT filesystem
            on the SD card, and run a read/write test at boot. Requires an SD card
            connected to the pins defined in test_config.h.

    config EXAMPLE_ENABLE_TEST_RTC
        bool "Enable RX8025T-UC RTC test module"
        default y
        help
            Enable this option to probe the board-mounted RX8025T-UC RTC on
            the board-owned shared I2C bus (I2C_NUM_1, GPIO7/8), read its time and
            status registers, sync invalid time from firmware build time, and
            start a periodic task to print decoded time every 5 seconds.

    config EXAMPLE_ENABLE_TEST_AUDIO
        bool "Enable audio (I2S + ES8311) test module"
        default y
        help
            Enable this option to initialize the I2S peripheral and ES8311 codec,
            start the audio backend task, and expose three UI-triggered actions:
            play embedded canon.pcm, record audio into memory, and replay the
            recorded audio. The codec borrows the board-owned shared I2C bus. GPIO20 is used
            for the power amplifier enable.

    config EXAMPLE_ENABLE_TEST_BATTERY
        bool "Enable battery voltage monitor test module"
        default y
        help
            Enable this option to initialize ADC2 channel 3 on GPIO52, sample
            the BAT divider midpoint (68K/100K), and expose battery voltage and
            percent state to the integrated LVGL demo.

    config EXAMPLE_VOICE_VOLUME
        int "Audio output volume"
        range 0 100
        default 60
        depends on EXAMPLE_ENABLE_TEST_AUDIO
        help
            Set the ES8311 codec output volume (0-100).

    choice EXAMPLE_MIC_GAIN
        prompt "Microphone gain"
        depends on EXAMPLE_ENABLE_TEST_AUDIO
        default MIC_GAIN_18DB

        config MIC_GAIN_0DB
            bool "0dB"
        config MIC_GAIN_6DB
            bool "6dB"
        config MIC_GAIN_12DB
            bool "12dB"
        config MIC_GAIN_18DB
            bool "18dB"
        config MIC_GAIN_24DB
            bool "24dB"
        config MIC_GAIN_30DB
            bool "30dB"
        config MIC_GAIN_36DB
            bool "36dB"
        config MIC_GAIN_42DB
            bool "42dB"
    endchoice

    config EXAMPLE_MIC_GAIN
        int
        default 0 if MIC_GAIN_0DB
        default 1 if MIC_GAIN_6DB
        default 2 if MIC_GAIN_12DB
        default 3 if MIC_GAIN_18DB
        default 4 if MIC_GAIN_24DB
        default 5 if MIC_GAIN_30DB
        default 6 if MIC_GAIN_36DB
        default 7 if MIC_GAIN_42DB

    choice EXAMPLE_USB_ROLE
        prompt "Enable USB controller[0] test capability"
        default EXAMPLE_ENABLE_TEST_UVC
        help
            Select the enabled test capability for the HIGH USB port (DWC OTG
            controller[0], internal UTMI HS PHY). One controller cannot be
            device and host at the same time, so the two capabilities are
            mutually exclusive. The USB role framework starts idle and the UI
            switches controller[0] on demand. The FULL USB port (USB
            Serial/JTAG, GPIO24/25) always provides the serial console.

    config EXAMPLE_ENABLE_TEST_USB
        bool "USB Device CDC-ACM echo"
        help
            Install a TinyUSB CDC-ACM Device echo demo on the HIGH USB port.
            The board enumerates as a virtual serial port on the PC side,
            dumps received data in hex, and echoes it back unchanged.

    config EXAMPLE_ENABLE_TEST_UVC
        bool "USB UVC camera host"
        help
            Install the USB Host Library on the HIGH USB port, run the
            esp-usb UVC host driver, and decode incoming MJPEG frames with
            the ESP32-P4 hardware JPEG decoder.

            The LVGL UVC test page initializes this module on demand, renders
            a scaled RGB565 preview, and lists MJPEG resolutions reported by
            the camera. The selected resolution is reopened asynchronously;
            returning to the main page releases the UVC Host resources.
    endchoice

    config EXAMPLE_UVC_ENABLE_PPA_PREVIEW
        bool "Enable UVC PPA preview scaling"
        depends on EXAMPLE_ENABLE_TEST_UVC
        default n
        help
            Use the PPA SRM client to scale decoded UVC frames into the preview
            buffer. Keep this disabled while validating UVC stability because
            the display pipeline also uses DMA2D/PPA resources. The CPU scaler
            is slower but isolates the UVC preview path from that shared engine.

    config EXAMPLE_ENABLE_TEST_WIRELESS
        bool "Enable WiFi/BLE test module"
        default y
        help
            Enable this option to expose the board-level ESP32-P4 <-> ESP32-C6
            wireless test module. WiFi uses esp_hosted + esp_wifi_remote over
            SDIO. BLE uses hosted NimBLE Host-only on ESP32-P4 with the
            ESP32-C6 BLE controller reached through ESP-Hosted VHCI.

    config EXAMPLE_WIRELESS_ENABLE_WIFI
        bool "Enable WiFi status/actions in wireless module"
        depends on EXAMPLE_ENABLE_TEST_WIRELESS
        default y
        help
            Keep WiFi actions and status visible in the wireless demo card.

    config EXAMPLE_WIRELESS_ENABLE_BLE
        bool "Enable BLE status/actions in wireless module"
        depends on EXAMPLE_ENABLE_TEST_WIRELESS
        default y
        help
            Enable the BLE Peripheral smoke-test path. The first version
            starts connectable advertising and exposes one small read/write
            GATT characteristic for validation with a phone BLE scanner.

    config EXAMPLE_WIRELESS_DEFAULT_WIFI_SSID
        string "Default WiFi SSID for demo connect action"
        depends on EXAMPLE_ENABLE_TEST_WIRELESS && EXAMPLE_WIRELESS_ENABLE_WIFI
        default ""
        help
            Optional default SSID used by the demo "WiFi Join" action.

    config EXAMPLE_WIRELESS_DEFAULT_WIFI_PASSWORD
        string "Default WiFi password for demo connect action"
        depends on EXAMPLE_ENABLE_TEST_WIRELESS && EXAMPLE_WIRELESS_ENABLE_WIFI
        default ""
        help
            Optional default password used by the demo "WiFi Join" action.

    config EXAMPLE_WIRELESS_MAXIMUM_RETRY
        int "Wireless WiFi maximum retry"
        depends on EXAMPLE_ENABLE_TEST_WIRELESS && EXAMPLE_WIRELESS_ENABLE_WIFI
        default 5
        help
            Maximum reconnect attempts used by the WiFi STA demo path.

    choice EXAMPLE_WIRELESS_SCAN_AUTH_MODE_THRESHOLD
        prompt "Wireless WiFi scan auth mode threshold"
        depends on EXAMPLE_ENABLE_TEST_WIRELESS && EXAMPLE_WIRELESS_ENABLE_WIFI
        default EXAMPLE_WIRELESS_AUTH_WPA2_PSK
        help
            Weakest AP auth mode accepted by the demo WiFi station logic.

        config EXAMPLE_WIRELESS_AUTH_OPEN
            bool "OPEN"
        config EXAMPLE_WIRELESS_AUTH_WEP
            bool "WEP"
        config EXAMPLE_WIRELESS_AUTH_WPA_PSK
            bool "WPA PSK"
        config EXAMPLE_WIRELESS_AUTH_WPA2_PSK
            bool "WPA2 PSK"
        config EXAMPLE_WIRELESS_AUTH_WPA_WPA2_PSK
            bool "WPA/WPA2 PSK"
        config EXAMPLE_WIRELESS_AUTH_WPA3_PSK
            bool "WPA3 PSK"
        config EXAMPLE_WIRELESS_AUTH_WPA2_WPA3_PSK
            bool "WPA2/WPA3 PSK"
        config EXAMPLE_WIRELESS_AUTH_WAPI_PSK
            bool "WAPI PSK"
    endchoice

endmenu
```

## esp32p4/JC1060P470/sdkconfig.defaults
```kconfig
CONFIG_LV_CONF_SKIP=y
CONFIG_LV_COLOR_DEPTH_16=y
CONFIG_LV_USE_BUILTIN_MALLOC=n
CONFIG_LV_USE_CLIB_MALLOC=y
CONFIG_LV_FONT_MONTSERRAT_16=y
CONFIG_LV_FONT_DEFAULT_MONTSERRAT_16=y
CONFIG_LV_USE_FS_STDIO=y
CONFIG_LV_FS_STDIO_LETTER=65
CONFIG_LV_FS_STDIO_PATH="/spiffs"
CONFIG_LV_FS_STDIO_CACHE_SIZE=4096
CONFIG_ESP_LVGL_ADAPTER_ENABLE_FREETYPE=y
CONFIG_ESP_LVGL_ADAPTER_FREETYPE_SMALL_RENDER_POOL=y
# CONFIG_ESP_LVGL_ADAPTER_FREETYPE_MINIMAL_BUILD is not set
CONFIG_LV_USE_FREETYPE=y
CONFIG_LV_FREETYPE_USE_LVGL_PORT=y
CONFIG_LV_FREETYPE_CACHE_FT_GLYPH_CNT=32
CONFIG_LV_USE_FONT_MANAGER=n
CONFIG_LV_USE_TINY_TTF=n
CONFIG_LV_BUILD_EXAMPLES=n
CONFIG_LV_BUILD_DEMOS=n
CONFIG_LV_USE_LOG=y
CONFIG_LV_LOG_LEVEL_WARN=y
CONFIG_LV_USE_FLOAT=y
CONFIG_LV_USE_GESTURE_RECOGNITION=y
CONFIG_LV_DRAW_THREAD_STACK_SIZE=32768
CONFIG_ESP_LCD_TOUCH_MAX_POINTS=5
CONFIG_LV_USE_OBSERVER=y
CONFIG_LV_USE_SYSMON=y
CONFIG_LV_USE_PERF_MONITOR=y
# CONFIG_LV_USE_PPA is not set
CONFIG_LV_DRAW_SW_DRAW_UNIT_CNT=1
CONFIG_LV_DEF_REFR_PERIOD=10
CONFIG_EXAMPLE_LVGL_PERF_LOG=y
CONFIG_FREERTOS_HZ=200
CONFIG_EXAMPLE_ENABLE_TEST_UVC=y
# CONFIG_EXAMPLE_ENABLE_TEST_USB is not set
CONFIG_IDF_EXPERIMENTAL_FEATURES=y
CONFIG_ESPTOOLPY_FLASHSIZE_16MB=y
CONFIG_PARTITION_TABLE_CUSTOM=y
CONFIG_PARTITION_TABLE_CUSTOM_FILENAME="partitions.csv"
CONFIG_TINYUSB_CDC_ENABLED=y
CONFIG_TINYUSB_CDC_COUNT=1

# USB Host Library (esp-usb managed component) for UVC camera test module.
# These take effect only when espressif/usb and espressif/usb_host_uvc are
# pulled in via EXAMPLE_ENABLE_TEST_UVC.
CONFIG_USB_HOST_CONTROL_TRANSFER_MAX_SIZE=3000
CONFIG_USB_HOST_HW_BUFFER_BIAS_IN=y
CONFIG_USB_HOST_DWC_DMA_CAP_MEMORY_IN_PSRAM=y
# CONFIG_UVC_PRINTF_CONFIGURATION_DESCRIPTOR is not set
CONFIG_SPIRAM_MALLOC_RESERVE_INTERNAL=150000
```

## esp32p4/JC1060P470/sdkconfig.defaults.esp32p4
```kconfig
CONFIG_SPIRAM=y
CONFIG_SPIRAM_MODE_HEX=y
CONFIG_SPIRAM_SPEED_200M=y
CONFIG_SPIRAM_ALLOW_STACK_EXTERNAL_MEMORY=n
CONFIG_ESP_HOSTED_ENABLED=y
CONFIG_SLAVE_IDF_TARGET_ESP32C6=y
CONFIG_ESP_HOSTED_CP_TARGET_ESP32C6=y
CONFIG_ESP_HOSTED_P4_DEV_BOARD_FUNC_BOARD=y
CONFIG_ESP_HOSTED_SDIO_HOST_INTERFACE=y
CONFIG_ESP_HOSTED_SDIO_SLOT_1=y
CONFIG_ESP_HOSTED_SDIO_4_BIT_BUS=y
CONFIG_ESP_HOSTED_SDIO_CLOCK_FREQ_KHZ=25000
CONFIG_ESP_HOSTED_SDIO_BUS_WIDTH=4
CONFIG_ESP_HOSTED_SDIO_TX_Q_SIZE=6
CONFIG_ESP_HOSTED_SDIO_RX_Q_SIZE=6
CONFIG_ESP_HOSTED_MEMPOOL_PREFER_SPIRAM=y
CONFIG_ESP_HOSTED_PRIV_SDIO_PIN_CMD_SLOT_1=19
CONFIG_ESP_HOSTED_PRIV_SDIO_PIN_CLK_SLOT_1=18
CONFIG_ESP_HOSTED_PRIV_SDIO_PIN_D0_SLOT_1=14
CONFIG_ESP_HOSTED_PRIV_SDIO_PIN_D1_4BIT_BUS_SLOT_1=15
CONFIG_ESP_HOSTED_PRIV_SDIO_PIN_D2_4BIT_BUS_SLOT_1=16
CONFIG_ESP_HOSTED_PRIV_SDIO_PIN_D3_4BIT_BUS_SLOT_1=17
CONFIG_WIFI_RMT_STATIC_RX_BUFFER_NUM=16
CONFIG_WIFI_RMT_DYNAMIC_RX_BUFFER_NUM=64
CONFIG_WIFI_RMT_DYNAMIC_TX_BUFFER_NUM=64
CONFIG_WIFI_RMT_AMPDU_TX_ENABLED=y
CONFIG_WIFI_RMT_TX_BA_WIN=32
CONFIG_WIFI_RMT_AMPDU_RX_ENABLED=y
CONFIG_WIFI_RMT_RX_BA_WIN=32
CONFIG_BT_ENABLED=y
CONFIG_BT_CONTROLLER_DISABLED=y
CONFIG_BT_BLUEDROID_ENABLED=n
CONFIG_BT_NIMBLE_ENABLED=y
CONFIG_BT_NIMBLE_TRANSPORT_UART=n
CONFIG_ESP_HOSTED_ENABLE_BT_NIMBLE=y
CONFIG_ESP_HOSTED_NIMBLE_HCI_VHCI=y
CONFIG_LWIP_TCP_SND_BUF_DEFAULT=65534
CONFIG_LWIP_TCP_WND_DEFAULT=65534
CONFIG_LWIP_TCP_RECVMBOX_SIZE=64
CONFIG_LWIP_UDP_RECVMBOX_SIZE=64
CONFIG_LWIP_TCPIP_RECVMBOX_SIZE=64
CONFIG_LWIP_TCP_SACK_OUT=y

# ESP32-P4 chip revision: target V1.0 (use hw_ver1 register definitions).
# The <3.0 and >=3.0 register sets are mutually exclusive; this selects the
# pre-v3 path and sets the minimum supported revision to 1.00.
CONFIG_ESP32P4_SELECTS_REV_LESS_V3=y
CONFIG_ESP32P4_REV_MIN_100=y
CONFIG_ESP32P4_REV_MIN_FULL=100
CONFIG_ESP_REV_MIN_FULL=100
```
