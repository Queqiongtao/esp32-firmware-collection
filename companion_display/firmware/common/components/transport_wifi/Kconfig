## esp32p4/PrintSphere/main/Kconfig.projbuild
```kconfig
menu "PrintSphere P4"

    config PRINTSPHERE_EXPERIMENTAL_PRINT_CONTROL
        bool "Enable experimental print control buttons"
        default n

    config PRINTSPHERE_CAMERA_TARGET_FPS
        int "Camera preview target frame rate (fps)"
        range 1 10
        default 5

    config EXAMPLE_USE_DMA2D_COPY_FRAME
        bool "Use ESP LCD DMA2D draw hook"
        default y

    config EXAMPLE_LVGL_PORT_ESP_ADAPTER
        bool
        default y

    config EXAMPLE_LVGL_PORT_CUSTOM_LEGACY
        bool
        default n

    config EXAMPLE_LVGL_ADAPTER_TEAR_DOUBLE_DIRECT
        bool
        default y

    config EXAMPLE_LVGL_ADAPTER_TEAR_TRIPLE_PARTIAL
        bool
        default n

    config EXAMPLE_LVGL_ADAPTER_TEAR_DOUBLE_FULL
        bool
        default n

    config EXAMPLE_LVGL_ADAPTER_FORCE_PARTIAL_DMA2D_TEST
        bool
        default n

    config EXAMPLE_LVGL_ADAPTER_ENABLE_PPA_ACCEL
        bool
        default y

    config EXAMPLE_LCD_BACKLIGHT_BYPASS_PWM
        bool "Bypass PWM and force backlight on"
        default n

    config EXAMPLE_LVGL_PERF_LOG
        bool "Log LVGL refresh performance"
        default n

    config EXAMPLE_LVGL_DRAW_BUF_LINES
        int
        range 20 200
        default 80

    config EXAMPLE_LVGL_DRAW_BUF_INTERNAL
        bool
        default n

endmenu
```

## esp32p4/PrintSphere/sdkconfig.defaults
```kconfig
CONFIG_ESPTOOLPY_FLASHMODE_DIO=y
CONFIG_ESPTOOLPY_FLASHSIZE_16MB=y
CONFIG_PARTITION_TABLE_CUSTOM=y
CONFIG_PARTITION_TABLE_CUSTOM_FILENAME="partitions.csv"
CONFIG_BOOTLOADER_APP_ROLLBACK_ENABLE=y

CONFIG_SPIRAM=y
CONFIG_SPIRAM_MODE_HEX=y
CONFIG_SPIRAM_SPEED_200M=y
CONFIG_SPIRAM_FETCH_INSTRUCTIONS=y
CONFIG_SPIRAM_RODATA=y
CONFIG_SPIRAM_MALLOC_ALWAYSINTERNAL=16384
CONFIG_SPIRAM_MALLOC_RESERVE_INTERNAL=150000
CONFIG_SPIRAM_TRY_ALLOCATE_WIFI_LWIP=y

CONFIG_COMPILER_OPTIMIZATION_PERF=y
CONFIG_LOG_DEFAULT_LEVEL_INFO=y
CONFIG_FREERTOS_HZ=200
CONFIG_PM_ENABLE=y

CONFIG_LV_CONF_SKIP=y
CONFIG_LV_COLOR_DEPTH_16=y
CONFIG_LV_USE_BUILTIN_MALLOC=n
CONFIG_LV_USE_CLIB_MALLOC=y
CONFIG_LV_USE_CLIB_STRING=y
CONFIG_LV_USE_CLIB_SPRINTF=y
CONFIG_LV_CACHE_DEF_SIZE=1048576
CONFIG_LV_IMAGE_HEADER_CACHE_DEF_CNT=32
CONFIG_LV_DEF_REFR_PERIOD=10
CONFIG_LV_OBJ_STYLE_CACHE=y
CONFIG_LV_DRAW_SW_DRAW_UNIT_CNT=1
CONFIG_LV_USE_LOG=y
CONFIG_LV_LOG_PRINTF=y
CONFIG_LV_FONT_MONTSERRAT_16=y
CONFIG_LV_FONT_MONTSERRAT_18=y
CONFIG_LV_FONT_MONTSERRAT_20=y
CONFIG_LV_FONT_MONTSERRAT_24=y
CONFIG_LV_FONT_MONTSERRAT_32=y
CONFIG_LV_FONT_MONTSERRAT_40=y
CONFIG_LV_FONT_FMT_TXT_LARGE=y
CONFIG_LV_USE_FONT_COMPRESSED=y
CONFIG_LV_BUILD_EXAMPLES=n
CONFIG_LV_BUILD_DEMOS=n
CONFIG_LV_USE_FLOAT=y
CONFIG_LV_USE_GESTURE_RECOGNITION=y
CONFIG_LV_USE_OBSERVER=y
# CONFIG_LV_USE_PPA is not set
CONFIG_ESP_LCD_TOUCH_MAX_POINTS=5

CONFIG_ESP_LVGL_ADAPTER_ENABLE_DECODER=y
CONFIG_ESP_LVGL_ADAPTER_PARTIAL_AUX_IMG_CACHE=y

CONFIG_MBEDTLS_DYNAMIC_BUFFER=y
CONFIG_MBEDTLS_EXTERNAL_MEM_ALLOC=y
CONFIG_MBEDTLS_DYNAMIC_FREE_CONFIG_DATA=y
CONFIG_MBEDTLS_DYNAMIC_FREE_CA_CERT=y
# CONFIG_MBEDTLS_INTERNAL_MEM_ALLOC is not set
# CONFIG_MBEDTLS_SSL_KEEP_PEER_CERTIFICATE is not set
CONFIG_MBEDTLS_SSL_IN_CONTENT_LEN=16384
CONFIG_MBEDTLS_SSL_OUT_CONTENT_LEN=4096
CONFIG_MBEDTLS_CERTIFICATE_BUNDLE_DEFAULT_CMN=y
CONFIG_ESP_TLS_INSECURE=y
CONFIG_ESP_TLS_SKIP_SERVER_CERT_VERIFY=y

CONFIG_LWIP_MAX_SOCKETS=16
CONFIG_LWIP_TCP_SND_BUF_DEFAULT=65534
CONFIG_LWIP_TCP_WND_DEFAULT=65534
CONFIG_LWIP_TCP_RECVMBOX_SIZE=64
CONFIG_LWIP_UDP_RECVMBOX_SIZE=64
CONFIG_LWIP_TCPIP_RECVMBOX_SIZE=64
CONFIG_LWIP_TCP_SACK_OUT=y

CONFIG_FATFS_LFN_HEAP=y
CONFIG_FATFS_MAX_LFN=255
CONFIG_IDF_EXPERIMENTAL_FEATURES=y

CONFIG_EXAMPLE_USE_DMA2D_COPY_FRAME=y
CONFIG_EXAMPLE_LVGL_PORT_ESP_ADAPTER=y
CONFIG_EXAMPLE_LVGL_ADAPTER_TEAR_DOUBLE_DIRECT=y
CONFIG_EXAMPLE_LVGL_ADAPTER_ENABLE_PPA_ACCEL=y
CONFIG_EXAMPLE_LVGL_DRAW_BUF_LINES=80
# CONFIG_EXAMPLE_LVGL_PERF_LOG is not set
```

## esp32p4/PrintSphere/sdkconfig.defaults.esp32p4
```kconfig
CONFIG_SPIRAM=y
CONFIG_SPIRAM_MODE_HEX=y
CONFIG_SPIRAM_SPEED_200M=y
CONFIG_FREERTOS_TASK_CREATE_ALLOW_EXT_MEM=y

CONFIG_ESP_HOSTED_ENABLED=y
CONFIG_SLAVE_IDF_TARGET_ESP32C6=y
CONFIG_ESP_HOSTED_CP_TARGET_ESP32C6=y
CONFIG_ESP_HOSTED_P4_DEV_BOARD_FUNC_BOARD=y
CONFIG_ESP_HOSTED_SDIO_HOST_INTERFACE=y
CONFIG_ESP_HOSTED_SDIO_SLOT_1=y
CONFIG_ESP_HOSTED_SDIO_4_BIT_BUS=y
CONFIG_ESP_HOSTED_SDIO_CLOCK_FREQ_KHZ=25000
CONFIG_ESP_HOSTED_SDIO_BUS_WIDTH=4
CONFIG_ESP_HOSTED_SDIO_TX_Q_SIZE=20
CONFIG_ESP_HOSTED_SDIO_RX_Q_SIZE=20
CONFIG_ESP_HOSTED_MEMPOOL_PREFER_SPIRAM=y
CONFIG_ESP_HOSTED_PRIV_SDIO_PIN_CMD_SLOT_1=19
CONFIG_ESP_HOSTED_PRIV_SDIO_PIN_CLK_SLOT_1=18
CONFIG_ESP_HOSTED_PRIV_SDIO_PIN_D0_SLOT_1=14
CONFIG_ESP_HOSTED_PRIV_SDIO_PIN_D1_4BIT_BUS_SLOT_1=15
CONFIG_ESP_HOSTED_PRIV_SDIO_PIN_D2_4BIT_BUS_SLOT_1=16
CONFIG_ESP_HOSTED_PRIV_SDIO_PIN_D3_4BIT_BUS_SLOT_1=17

CONFIG_WIFI_RMT_STATIC_RX_BUFFER_NUM=16
CONFIG_WIFI_RMT_DYNAMIC_RX_BUFFER_NUM=64
CONFIG_WIFI_RMT_DYNAMIC_TX_BUFFER_NUM=64
CONFIG_WIFI_RMT_AMPDU_TX_ENABLED=y
CONFIG_WIFI_RMT_TX_BA_WIN=32
CONFIG_WIFI_RMT_AMPDU_RX_ENABLED=y
CONFIG_WIFI_RMT_RX_BA_WIN=32

CONFIG_ESP32P4_SELECTS_REV_LESS_V3=y
CONFIG_ESP32P4_REV_MIN_100=y
CONFIG_ESP32P4_REV_MIN_FULL=100
CONFIG_ESP_REV_MIN_FULL=100
```

## esp32p4/clock/sdkconfig.defaults
```kconfig
# ESP32-P4-WIFI6-Touch-LCD-3.4C clock project defaults
# Target the ESP32-P4 v1.0 silicon used on this board: 360 MHz CPU,
# 200 MHz HEX PSRAM, and the pre-v3 register set.
CONFIG_IDF_TARGET="esp32p4"
CONFIG_ESP32P4_SELECTS_REV_LESS_V3=y
CONFIG_ESP32P4_REV_MIN_100=y
CONFIG_ESP32P4_REV_MIN_FULL=100
CONFIG_ESP_REV_MIN_FULL=100
CONFIG_ESPTOOLPY_FLASHMODE_QIO=y
CONFIG_ESPTOOLPY_FLASHSIZE_32MB=y
CONFIG_PARTITION_TABLE_CUSTOM=y
CONFIG_PARTITION_TABLE_CUSTOM_FILENAME="partitions.csv"
CONFIG_IDF_EXPERIMENTAL_FEATURES=y

CONFIG_SPIRAM=y
CONFIG_SPIRAM_MODE_HEX=y
CONFIG_SPIRAM_SPEED_200M=y
CONFIG_SPIRAM_SPEED=200
CONFIG_SPIRAM_FETCH_INSTRUCTIONS=y
CONFIG_SPIRAM_RODATA=y
CONFIG_SPIRAM_XIP_FROM_PSRAM=y
CONFIG_SPIRAM_MALLOC_ALWAYSINTERNAL=0
CONFIG_SPIRAM_MALLOC_RESERVE_INTERNAL=32768
CONFIG_CACHE_L2_CACHE_256KB=y
CONFIG_CACHE_L2_CACHE_LINE_128B=y

CONFIG_COMPILER_OPTIMIZATION_PERF=y
CONFIG_ESP_DEFAULT_CPU_FREQ_MHZ_360=y
# The clock app does not use light sleep. On P4 v1.0 the default clock-ICG
# retention initialization can fail before app_main, so keep it disabled.
CONFIG_PM_SLEEP_CLK_ICG_ENABLE=n
CONFIG_ESP_MAIN_TASK_STACK_SIZE=12288
CONFIG_FREERTOS_HZ=1000
CONFIG_FREERTOS_TASK_CREATE_ALLOW_EXT_MEM=y

CONFIG_LV_COLOR_DEPTH_16=y
CONFIG_LV_COLOR_DEPTH=16
CONFIG_LV_OS_FREERTOS=y
CONFIG_LV_USE_CLIB_MALLOC=y
CONFIG_LV_USE_CLIB_STRING=y
CONFIG_LV_USE_CLIB_SPRINTF=y
CONFIG_LV_DEF_REFR_PERIOD=15
CONFIG_LV_OBJ_STYLE_CACHE=y
CONFIG_LV_DRAW_SW_DRAW_UNIT_CNT=2
CONFIG_LV_USE_LOG=y
CONFIG_LV_LOG_PRINTF=y
CONFIG_LV_FONT_MONTSERRAT_8=y
CONFIG_LV_FONT_MONTSERRAT_10=y
CONFIG_LV_FONT_MONTSERRAT_12=y
CONFIG_LV_FONT_MONTSERRAT_14=y
CONFIG_LV_FONT_MONTSERRAT_16=y
CONFIG_LV_FONT_MONTSERRAT_18=y
CONFIG_LV_FONT_MONTSERRAT_20=y
CONFIG_LV_FONT_MONTSERRAT_22=y
CONFIG_LV_FONT_MONTSERRAT_24=y
CONFIG_LV_FONT_MONTSERRAT_26=y
CONFIG_LV_FONT_MONTSERRAT_28=y
CONFIG_LV_FONT_MONTSERRAT_30=y
CONFIG_LV_FONT_MONTSERRAT_32=y
CONFIG_LV_FONT_MONTSERRAT_34=y
CONFIG_LV_FONT_MONTSERRAT_36=y
CONFIG_LV_FONT_MONTSERRAT_38=y
CONFIG_LV_FONT_MONTSERRAT_40=y
CONFIG_LV_FONT_MONTSERRAT_42=y
CONFIG_LV_FONT_MONTSERRAT_44=y
CONFIG_LV_FONT_MONTSERRAT_48=y
CONFIG_LV_FONT_FMT_TXT_LARGE=y
CONFIG_LV_USE_FONT_COMPRESSED=y
CONFIG_LV_USE_SNAPSHOT=y
CONFIG_LV_BUILD_EXAMPLES=n

CONFIG_BSP_LCD_TYPE_800_800_3_4_INCH=y
# CONFIG_BSP_LCD_TYPE_720_720_4_INCH is not set
CONFIG_BSP_LCD_COLOR_FORMAT_RGB565=y
CONFIG_BSP_LCD_DPI_BUFFER_NUMS=3

CONFIG_LWIP_SNTP_MAX_SERVERS=3
CONFIG_LWIP_SNTP_UPDATE_DELAY=7200000

# ESP32-P4 uses the on-board ESP32-C6 through ESP-Hosted over SDIO.
CONFIG_SLAVE_IDF_TARGET_ESP32C6=y
CONFIG_WIFI_RMT_STATIC_RX_BUFFER_NUM=16
CONFIG_WIFI_RMT_DYNAMIC_RX_BUFFER_NUM=64
CONFIG_WIFI_RMT_DYNAMIC_TX_BUFFER_NUM=64
CONFIG_WIFI_RMT_AMPDU_TX_ENABLED=y
CONFIG_WIFI_RMT_TX_BA_WIN=32
CONFIG_WIFI_RMT_AMPDU_RX_ENABLED=y
CONFIG_WIFI_RMT_RX_BA_WIN=32

CONFIG_PARTITION_TABLE_OFFSET=0x10000

# ESP-Hosted SDIO wiring for ESP32-P4-WIFI6-Touch-LCD-3.4C (on-board ESP32-C6)
CONFIG_ESP_HOSTED_CP_TARGET_ESP32C6=y
CONFIG_ESP_HOSTED_P4_DEV_BOARD_NONE=y
CONFIG_ESP_HOSTED_SDIO_SLOT_1=y
CONFIG_ESP_HOSTED_SDIO_4_BIT_BUS=y
CONFIG_ESP_HOSTED_SDIO_RESET_ACTIVE_HIGH=y
CONFIG_ESP_HOSTED_SDIO_PIN_CMD=19
CONFIG_ESP_HOSTED_SDIO_PIN_CLK=18
CONFIG_ESP_HOSTED_SDIO_PIN_D0=14
CONFIG_ESP_HOSTED_SDIO_PIN_D1=15
CONFIG_ESP_HOSTED_SDIO_PIN_D2=16
CONFIG_ESP_HOSTED_SDIO_PIN_D3=17
CONFIG_ESP_HOSTED_SDIO_GPIO_RESET_SLAVE=54
CONFIG_ESP_HOSTED_SDIO_CLOCK_FREQ_KHZ=40000
```

## esp32p4/mipi_dsi/main/Kconfig.projbuild
```kconfig
menu "Example Configuration"
    config EXAMPLE_USE_DMA2D_COPY_FRAME
        bool "Use DMA2D to copy draw buffer to frame buffer"
        default y
        help
            Enable this option, DMA2D will be used to copy the LVGL draw buffer to the target frame buffer.
            This can save some CPU time and improve the performance.

    config EXAMPLE_MONITOR_REFRESH_BY_GPIO
        bool "Monitor Refresh Rate by GPIO"
        default y
        help
            Enable this option, you can visualize the refresh rate by attaching a logic analyzer to a specific GPIO.
            The GPIO will output a square wave with the frequency equals to half of the refresh rate.

    config EXAMPLE_LCD_BACKLIGHT_BYPASS_PWM
        bool "Bypass PWM and force backlight always on"
        default n
        help
            Enable this option to drive the backlight pin as a fixed high level instead of PWM.
            This is useful for diagnosing whether visible flicker comes from PWM dimming or from the display pipeline.

    config EXAMPLE_LVGL_DRAW_BUF_LINES
        int "LVGL draw buffer lines"
        range 10 200
        default 80
        help
            Number of LCD lines in each LVGL partial draw buffer.
            Smaller values reduce single-buffer size and internal memory pressure.
            Larger values reduce flush count but consume more memory.

    choice
        prompt "LVGL draw buffer memory"
        default EXAMPLE_LVGL_DRAW_BUF_PSRAM
        help
            Select where the LVGL partial draw buffers are allocated from.

        config EXAMPLE_LVGL_DRAW_BUF_PSRAM
            bool "PSRAM"
        config EXAMPLE_LVGL_DRAW_BUF_INTERNAL
            bool "Internal RAM"
    endchoice

    choice
        prompt "Select MIPI LCD model"
        default EXAMPLE_LCD_USE_JD9165
        help
            Select LCD controller model.

        config EXAMPLE_LCD_USE_JD9165
            bool "JD9165"
        config EXAMPLE_LCD_USE_ILI9881C
            bool "ILI9881C"
    endchoice
endmenu
```

## esp32s3/amoled_fluid/components/block_physics/Kconfig
```kconfig
menu "Block Physics"

config BLOCK_PHYSICS_BLOCK_COUNT
    int "Block count"
    default 50
    range 40 60

config BLOCK_PHYSICS_BLOCK_MIN_SIZE
    int "Minimum block size (px)"
    default 12
    range 4 64

config BLOCK_PHYSICS_BLOCK_MAX_SIZE
    int "Maximum block size (px)"
    default 36
    range 8 96

config BLOCK_PHYSICS_COLOR_COUNT
    int "Palette color count (max 16)"
    default 9
    range 4 16

config BLOCK_PHYSICS_PHYSICS_HZ
    int "Physics update rate (Hz)"
    default 60
    range 30 120

config BLOCK_PHYSICS_RENDER_HZ
    int "Render target rate (Hz)"
    default 30
    range 10 60

config BLOCK_PHYSICS_ITERATIONS
    int "Collision iterations per physics step"
    default 3
    range 1 8

config BLOCK_PHYSICS_GRAVITY_ACC_Q8
    int "Gravity acceleration at 1g (Q8.8 px/step^2)"
    default 56
    range 4 120

config BLOCK_PHYSICS_DAMPING_Q8
    int "Velocity damping per step (Q8.8)"
    default 252
    range 200 255

config BLOCK_PHYSICS_RESTITUTION_Q8
    int "Bounce restitution (Q8.8)"
    default 32
    range 0 255

config BLOCK_PHYSICS_FRICTION_Q8
    int "Contact friction (Q8.8, fraction of tangential velocity removed)"
    default 140
    range 0 255

config BLOCK_PHYSICS_ACCEL_LP_ALPHA
    int "IMU accel low-pass alpha (Q8.8)"
    default 64
    range 1 255

config BLOCK_PHYSICS_MAX_VEL_Q8
    int "Maximum block velocity (Q8.8 px/step)"
    default 2048
    range 256 4096

config BLOCK_PHYSICS_SHAKE_THRESHOLD
    int "Shake energy threshold (raw LSB)"
    default 6000
    range 0 200000

config BLOCK_PHYSICS_SHAKE_GAIN_Q8
    int "Shake impulse gain (Q8.8)"
    default 10
    range 1 255

config BLOCK_PHYSICS_IMU_SWAP_XY
    bool "Swap IMU X/Y axes (真机标定用)"
    default n

config BLOCK_PHYSICS_IMU_INVERT_X
    bool "Invert IMU X axis (真机标定用)"
    default n

config BLOCK_PHYSICS_IMU_INVERT_Y
    bool "Invert IMU Y axis (真机标定用)"
    default n

config BLOCK_PHYSICS_STATS_INTERVAL_MS
    int "Stats log interval (ms, 0 disables)"
    default 2000
    range 0 60000

endmenu
```

## esp32s3/amoled_fluid/components/fluid_render/Kconfig
```kconfig
menu "Fluid Render"

config FLUID_RENDER_SIM_W
    int "Simulation grid width (cells)"
    default 92
    range 8 368

config FLUID_RENDER_SIM_H
    int "Simulation grid height (cells)"
    default 112
    range 8 448

config FLUID_RENDER_SIM_HZ
    int "Simulation/render target rate (Hz)"
    default 30
    range 5 60

config FLUID_RENDER_BLOB_COUNT
    int "Blob count"
    default 8
    range 1 8

config FLUID_RENDER_BLOB_RADIUS_CELLS
    int "Blob base radius (grid cells)"
    default 6
    range 2 24

config FLUID_RENDER_MAX_STRETCH
    int "Max blob stretch along motion (percent)"
    default 135
    range 100 200

config FLUID_RENDER_STATS_INTERVAL_MS
    int "Stats log interval (ms, 0 disables)"
    default 2000
    range 0 60000

config FLUID_RENDER_DEBUG_COLOR_SEQ
    bool "Debug: show red/green/blue color sequence at startup (byte-order check)"
    default n

endmenu
```

## esp32s3/amoled_subscreen/components/usb_extend_screen/Kconfig
```kconfig
menu "USB Extend Screen"

config TUSB_VID
    hex "USB vendor ID"
    default 0x303A

config TUSB_PID
    hex "USB product ID"
    default 0x2987

config TUSB_MANUFACTURER
    string "USB manufacturer"
    default "Espressif"

config USB_EXTEND_SCREEN_HEIGHT
    int "Windows display width"
    default 368
    range 1 65535

config USB_EXTEND_SCREEN_WIDTH
    int "Windows display height"
    default 448
    range 1 65535

config USB_EXTEND_SCREEN_JPEG_QUALITY
    int "JPEG quality advertised to Windows driver"
    default 6
    range 1 10

config USB_EXTEND_SCREEN_MAX_FPS
    int "Maximum frames per second advertised to Windows driver"
    default 10
    range 1 60

config USB_EXTEND_SCREEN_FRAME_LIMIT_B
    int "Maximum JPEG frame size in bytes"
    default 100000
    range 1024 1048576

config USB_EXTEND_SCREEN_FRAME_BUFFER_COUNT
    int "JPEG frame buffer count"
    default 6
    range 2 8

config USB_TASK_PRIORITY
    int "TinyUSB task priority"
    default 6
    range 1 15

config USB_EXTEND_SCREEN_TRANSFER_TASK_PRIORITY
    int "JPEG transfer task priority"
    default 5
    range 1 15

endmenu
```
